## config/boards/shields/minidox/Kconfig.defconfig
```kconfig
if SHIELD_MINIDOX

config ZMK_MINIDOX
    default "MINIDOX"

config ZMK_SPLIT_BLE_ROLE_CENTRAL
    default y

endif

if SHIELD_MINIDOX_LEFT || SHIELD_MINIDOX_RIGHT

config ZMK_SPLIT
    default y

endif
```

## config/boards/shields/minidox/Kconfig.shield
```kconfig
# Copyright (c) 2021 The ZMK Contributors
# SPDX-License-Identifier: MIT

config SHIELD_MINIDOX_LEFT
    def_bool $(shields_list_contains,minidox_left)

config SHIELD_MINIDOX_RIGHT
    def_bool $(shields_list_contains,minidox_right)
```

## config/boards/shields/minidox_black/Kconfig.defconfig
```kconfig
# Copyright (c) 2021 The ZMK Contributors
# SPDX-License-Identifier: MIT

if SHIELD_MINIDOX_LEFT

config ZMK_KEYBOARD_NAME
    default "MINIDOX_BLACK"

config ZMK_SPLIT_BLE_ROLE_CENTRAL
    default y

endif

if SHIELD_MINIDOX_LEFT || SHIELD_MINIDOX_RIGHT

config ZMK_SPLIT
    default y

endif
```
